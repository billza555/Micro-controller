/* USER CODE BEGIN Header */
/**
  ******************************************************************************
  * @file           : main.c
  * @brief          : Main program body
  ******************************************************************************
  * @attention
  *
  * <h2><center>&copy; Copyright (c) 2021 STMicroelectronics.
  * All rights reserved.</center></h2>
  *
  * This software component is licensed by ST under BSD 3-Clause license,
  * the "License"; You may not use this file except in compliance with the
  * License. You may obtain a copy of the License at:
  *                        opensource.org/licenses/BSD-3-Clause
  *
  ******************************************************************************
  */
/* USER CODE END Header */
/* Includes ------------------------------------------------------------------*/
#include "main.h"
#include "adc.h"
#include "i2c.h"
#include "rng.h"
#include "spi.h"
#include "tim.h"
#include "usart.h"
#include "gpio.h"

/* Private includes ----------------------------------------------------------*/
/* USER CODE BEGIN Includes */
#include "stdio.h"
#include "ILI9341_Touchscreen.h"

#include "ILI9341_STM32_Driver.h"
#include "ILI9341_GFX.h"
#include "string.h"
/* USER CODE END Includes */

/* Private typedef -----------------------------------------------------------*/
/* USER CODE BEGIN PTD */
typedef enum {
    MENU,
    PROFILE
} State;
/* USER CODE END PTD */

/* Private define ------------------------------------------------------------*/
/* USER CODE BEGIN PD */
/* USER CODE END PD */

/* Private macro -------------------------------------------------------------*/
/* USER CODE BEGIN PM */

/* USER CODE END PM */

/* Private variables ---------------------------------------------------------*/

/* USER CODE BEGIN PV */
/* Private variables ---------------------------------------------------------*/
uint8_t red = 0;
uint8_t red_percent = 0;
uint8_t green = 0;
uint8_t green_percent = 0;
uint8_t blue = 0;
uint8_t blue_percent = 0;
float h=30.0,t=40.0;
uint8_t profile_counter = 0;
uint8_t profile_active = 0;
const uint16_t bill[] = {
		0xffff, 0xffff, 0xffff, 0xffff, 0xffff, 0xffff, 0xdf1c, 0xb5d7, 0xb596, 0xbe39, 0xefdf, 0xffff,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 0xe73c,
		0xffff, 0xffff, 0xffff, 0xffff, 0xffff, 0xffff, 0xef7e, 0xceba, 0xbe39, 0xc69a, 0xf7bf, 0xffff,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 0xef5c,
		0xffff, 0xffff, 0xffff, 0xffff, 0xffff, 0xffff, 0xffff, 0xf7df, 0xefbe, 0xef9e, 0xffdf, 0xffff,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 0xe75d,
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		0x8bec, 0x8bab, 0x8bcc, 0x93ec, 0x9c2d, 0x9c4e, 0x9c8f, 0xa4af, 0xa4b0, 0xb531, 0x6b2c, 0x18c5,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 0xd4d3
};
/* USER CODE END PV */

/* Private function prototypes -----------------------------------------------*/
void SystemClock_Config(void);
/* USER CODE BEGIN PFP */
/* Private function prototypes -----------------------------------------------*/

/* USER CODE END PFP */

/* Private user code ---------------------------------------------------------*/
/* USER CODE BEGIN 0 */
void ILI9341_Draw_PartImage(const uint16_t* image, uint16_t x, uint16_t y, uint16_t w, uint16_t h)
{
    ILI9341_Set_Address(x, y, x + w - 1, y + h - 1);

    ILI9341_Write_Command(0x2C);
    for (uint32_t i = 0; i < w * h; i++)
    {
        ILI9341_Write_Data(image[i] >> 8);
        ILI9341_Write_Data(image[i] & 0xFF);
    }
}
uint16_t CRC16_2(uint8_t *ptr, uint8_t length)
{
	uint16_t crc = 0xFFFF;
	uint8_t s = 0x00;
	while(length--){
		crc ^= *ptr++;
		for(s = 0; s < 8;s++)
		{
			if((crc & 0x01) != 0){
				crc >>= 1;
				crc ^= 0xA001;
			}else crc >>= 1;
		}
	}
	return crc;
}
uint16_t RGB565(uint8_t r, uint8_t g, uint8_t b) {
    return ((r & 0xF8) << 8) |
           ((g & 0xFC) << 3) |
           (b >> 3);
}
uint16_t LightenColor(uint16_t color, uint8_t percent)
{
    if (percent > 100) percent = 100;

    uint8_t r = (color >> 11) & 0x1F;
    uint8_t g = (color >> 5)  & 0x3F;
    uint8_t b =  color        & 0x1F;

    uint8_t rMax = 31;
    uint8_t gMax = 63;
    uint8_t bMax = 31;

    r = r + ((rMax - r) * percent) / 100;
    g = g + ((gMax - g) * percent) / 100;
    b = b + ((bMax - b) * percent) / 100;

    return (r << 11) | (g << 5) | b;
}
void ShowColor(uint16_t color, uint8_t percent, uint16_t position_y)
{
    ILI9341_Draw_Filled_Circle(20, position_y, 15, color);
    ILI9341_Draw_Rectangle(60, position_y - 10, 120, 20, LightenColor(color, 50));
    uint16_t filledWidth = (120 * percent) / 100;
    ILI9341_Draw_Rectangle(60, position_y - 10, filledWidth, 20, color);
    char buf[10];
    sprintf(buf, "%d %%", percent);
    ILI9341_Draw_Text(buf, 200, position_y, BLACK, 2, WHITE);
}
void ShowTemperture()
{
	char temp[10];
		sprintf(temp, "%4.1f C", t);
		ILI9341_Draw_Text(temp, 20, 20, BLACK, 2, WHITE);
		ILI9341_Draw_Filled_Circle(130, 30, 15, RGB565(red, green, blue));
		char humid[10];
		sprintf(humid, "%4.1f %%RH", h);
		ILI9341_Draw_Text(humid, 170, 20, BLACK, 2, WHITE);
}
void DisplayMenu()
{
	ILI9341_Fill_Screen(WHITE);
	ILI9341_Set_Rotation(SCREEN_HORIZONTAL_1);
	ShowTemperture();
	ShowColor(RED, red_percent, 80);
	ShowColor(GREEN, green_percent, 140);
	ShowColor(BLUE, blue_percent, 200);
}
void UpdateColor(uint8_t *color, uint8_t *percent)
{
    *percent = (*percent + 10) % 110;
    *color = (uint8_t)((*percent * 255) / 100);
    DisplayMenu();
}
void DisplayProfile(const uint16_t* image, const char *fn, const char *ln, int number)
{
    ILI9341_Fill_Screen(WHITE);
    ILI9341_Set_Rotation(SCREEN_HORIZONTAL_1);
    ILI9341_Draw_PartImage(image, 20, 60, 80, 100);
    static char firstname[20];
    sprintf(firstname, "%s", fn);
    static char lastname[20];
    sprintf(lastname, "%s", ln);
    static char studentId[10];
    sprintf(studentId, "%d", number);
    ILI9341_Draw_Text("GROUP NO.6", 120, 50, RGB565(red, green, blue), 2, WHITE);
    ILI9341_Draw_Text(firstname, 120, 100, RGB565(red, green, blue), 2, WHITE);
    ILI9341_Draw_Text(lastname, 120, 150, RGB565(red, green, blue), 2, WHITE);
    ILI9341_Draw_Text(studentId, 120, 200, RGB565(red, green, blue), 2, WHITE);
}
/* USER CODE END 0 */

/**
  * @brief  The application entry point.
  * @retval int
  */
int main(void)
{

  /* USER CODE BEGIN 1 */

  /* USER CODE END 1 */

  /* Enable the CPU Cache */

  /* Enable I-Cache---------------------------------------------------------*/
  SCB_EnableICache();

  /* Enable D-Cache---------------------------------------------------------*/
  SCB_EnableDCache();

  /* MCU Configuration--------------------------------------------------------*/

  /* Reset of all peripherals, Initializes the Flash interface and the Systick. */
  HAL_Init();

  /* USER CODE BEGIN Init */
  uint8_t cmdBuffer[3];
  uint8_t dataBuffer[8];
  volatile uint32_t adc_val = 0;
  float adc = 0;
  /* USER CODE END Init */

  /* Configure the system clock */
  SystemClock_Config();

  /* USER CODE BEGIN SysInit */

  /* USER CODE END SysInit */

  /* Initialize all configured peripherals */
  MX_GPIO_Init();
  MX_USART3_UART_Init();
  MX_SPI5_Init();
  MX_TIM1_Init();
  MX_RNG_Init();
  MX_I2C1_Init();
  MX_ADC1_Init();
  MX_TIM2_Init();
  /* USER CODE BEGIN 2 */
  ILI9341_Init();//initial driver setup to drive ili9341
  State state = MENU;
  DisplayMenu();
  cmdBuffer[0] = 0x03;
  cmdBuffer[1] = 0x00;
  cmdBuffer[2] = 0x04;
  HAL_ADC_Start(&hadc1);
  HAL_TIM_PWM_Start(&htim2, TIM_CHANNEL_4);
  /* USER CODE END 2 */

  /* Infinite loop */
  /* USER CODE BEGIN WHILE */
  while (1)
  {

    /* USER CODE END WHILE */

    /* USER CODE BEGIN 3 */
	  if(HAL_ADC_PollForConversion(&hadc1, 100) == HAL_OK)
	  {
		  adc_val = HAL_ADC_GetValue(&hadc1);
		  adc = (float)adc_val / 4095.0f;
		  if(adc < 0.2)
			  adc = 0.2f;
		  htim2.Instance -> CCR4 = (uint32_t)((10000 - 1) * adc);
	  }
	  switch(state)
	  {
	  	  case MENU:
	  		  profile_counter = 0;
	  		  if(TP_Touchpad_Pressed())
	  		  {
	  			  uint16_t position_array[2];
	  			  if(TP_Read_Coordinates(position_array) == TOUCHPAD_DATA_OK)
	  			  {
	  				  uint16_t x_pos = position_array[0];
	  				  uint16_t y_pos = position_array[1];

	  	    	       if((150 - x_pos) * (150 - x_pos) + (40 - y_pos) * (40 - y_pos) <= 15*15)
	  	    	       {
	  	    	    	   UpdateColor(&red, &red_percent);
	  	    	       }
	  	    	       if((100 - x_pos) * (100 - x_pos) + (40 - y_pos) * (40 - y_pos) <= 15*15)
	  	    	       {
	  	    	    	   UpdateColor(&green, &green_percent);
	  	    	       }
	  	    	       if((50 - x_pos) * (50 - x_pos) + (40 - y_pos) * (40 - y_pos) <= 15*15)
	  	    	       {
	  	    	    	   UpdateColor(&blue, &blue_percent);
	  	    	       }
	  	    	       if((210 - x_pos) * (210 - x_pos) + (140 - y_pos) * (140 - y_pos) <= 15*15)
	  	    	       {
	  	    	    	   state = PROFILE;
	  	    	    	   DisplayProfile(bill, "Rachchanon", "Klaisuban", 66010695);
	  	    	    	   profile_active = 1;
	  	    	    	   profile_counter = 0;
	  	    	    	   HAL_TIM_Base_Start_IT(&htim1);00
	  	    	    	   break;
	  	    	       }
	  			  }
	  		  }
	  		  HAL_I2C_Master_Transmit(&hi2c1, 0x5c<<1, cmdBuffer, 3, 200);
	  		  HAL_Delay(2);
	  		  HAL_I2C_Master_Transmit(&hi2c1, 0x5c<<1, cmdBuffer, 3, 200);
	  		  HAL_Delay(2);
	  		  HAL_I2C_Master_Receive(&hi2c1, 0x5c<<1, dataBuffer, 8, 200);
	  		  uint16_t Rcrc = dataBuffer[7] << 8;
	  		  Rcrc += dataBuffer[6];
	  		  if(Rcrc == CRC16_2(dataBuffer, 6)){
	  			  	  uint16_t tempertature = ((dataBuffer[4] & 0x7F) << 8) + dataBuffer[5];
	  			  	  t = tempertature / 10.0;
	  			  	  t = (((dataBuffer[4] & 0x80) >> 7) == 1) ? (t * (-1)) : t;
	  			  	  uint16_t humidity = (dataBuffer[2] << 8) + dataBuffer[3];
	  			  	  h = humidity / 10.0;
	  			  	  ShowTemperture();
	  		  }
	  		  break;
	  	  case PROFILE:
	  		  if(TP_Touchpad_Pressed())
	  		  {
	  			  uint16_t position_array[2];
	  			  if(TP_Read_Coordinates(position_array) == TOUCHPAD_DATA_OK)
	  			  {
	  				  uint16_t x_pos = position_array[0];
	  				  uint16_t y_pos = position_array[1];

	  				if(x_pos >= 100 && x_pos <= 160 &&
	  				   y_pos >= 40 && y_pos <= 120)
	  			  	  {
	  						profile_active = 0;
	  						profile_counter = 0;
	  						HAL_TIM_Base_Stop_IT(&htim1);
	  						state = MENU;
	  						DisplayMenu();
	  			  	  }
	  			  }
	  		  }
	  		  if(profile_counter >= 5)
	  		  {
	  			  profile_active = 0;
	  			  profile_counter = 0;
	  			  HAL_TIM_Base_Stop_IT(&htim1);
	  			  state = MENU;
	  			  DisplayMenu();
	  	    	}
	  	    	break;
	  	    default:
	  	    	break;
	 }
  }
  /* USER CODE END 3 */
}

/**
  * @brief System Clock Configuration
  * @retval None
  */
void SystemClock_Config(void)
{
  RCC_OscInitTypeDef RCC_OscInitStruct = {0};
  RCC_ClkInitTypeDef RCC_ClkInitStruct = {0};

  /** Configure LSE Drive Capability
  */
  HAL_PWR_EnableBkUpAccess();

  /** Configure the main internal regulator output voltage
  */
  __HAL_RCC_PWR_CLK_ENABLE();
  __HAL_PWR_VOLTAGESCALING_CONFIG(PWR_REGULATOR_VOLTAGE_SCALE1);

  /** Initializes the RCC Oscillators according to the specified parameters
  * in the RCC_OscInitTypeDef structure.
  */
  RCC_OscInitStruct.OscillatorType = RCC_OSCILLATORTYPE_HSE;
  RCC_OscInitStruct.HSEState = RCC_HSE_BYPASS;
  RCC_OscInitStruct.PLL.PLLState = RCC_PLL_ON;
  RCC_OscInitStruct.PLL.PLLSource = RCC_PLLSOURCE_HSE;
  RCC_OscInitStruct.PLL.PLLM = 4;
  RCC_OscInitStruct.PLL.PLLN = 200;
  RCC_OscInitStruct.PLL.PLLP = RCC_PLLP_DIV2;
  RCC_OscInitStruct.PLL.PLLQ = 9;
  RCC_OscInitStruct.PLL.PLLR = 2;
  if (HAL_RCC_OscConfig(&RCC_OscInitStruct) != HAL_OK)
  {
    Error_Handler();
  }

  /** Activate the Over-Drive mode
  */
  if (HAL_PWREx_EnableOverDrive() != HAL_OK)
  {
    Error_Handler();
  }

  /** Initializes the CPU, AHB and APB buses clocks
  */
  RCC_ClkInitStruct.ClockType = RCC_CLOCKTYPE_HCLK|RCC_CLOCKTYPE_SYSCLK
                              |RCC_CLOCKTYPE_PCLK1|RCC_CLOCKTYPE_PCLK2;
  RCC_ClkInitStruct.SYSCLKSource = RCC_SYSCLKSOURCE_PLLCLK;
  RCC_ClkInitStruct.AHBCLKDivider = RCC_SYSCLK_DIV1;
  RCC_ClkInitStruct.APB1CLKDivider = RCC_HCLK_DIV4;
  RCC_ClkInitStruct.APB2CLKDivider = RCC_HCLK_DIV2;

  if (HAL_RCC_ClockConfig(&RCC_ClkInitStruct, FLASH_LATENCY_6) != HAL_OK)
  {
    Error_Handler();
  }
}

/* USER CODE BEGIN 4 */

/* USER CODE END 4 */

/**
  * @brief  This function is executed in case of error occurrence.
  * @retval None
  */
void Error_Handler(void)
{
  /* USER CODE BEGIN Error_Handler_Debug */
  /* User can add his own implementation to report the HAL error return state */
  while(1)
  {
  }
  /* USER CODE END Error_Handler_Debug */
}
#ifdef USE_FULL_ASSERT
/**
  * @brief  Reports the name of the source file and the source line number
  *         where the assert_param error has occurred.
  * @param  file: pointer to the source file name
  * @param  line: assert_param error line source number
  * @retval None
  */
void assert_failed(uint8_t *file, uint32_t line)
{
  /* USER CODE BEGIN 6 */
  /* User can add his own implementation to report the file name and line number,
     tex: printf("Wrong parameters value: file %s on line %d\r\n", file, line) */
  /* USER CODE END 6 */
}
#endif /* USE_FULL_ASSERT */
